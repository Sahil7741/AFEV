/* USER CODE BEGIN Header */
/**
  ******************************************************************************
  * @file           : main.c
  * @brief          : Main program body
  ******************************************************************************
  * @attention
  *
  * Copyright (c) 2024 STMicroelectronics.
  * All rights reserved.
  *
  * This software is licensed under terms that can be found in the LICENSE file
  * in the root directory of this software component.
  * If no LICENSE file comes with this software, it is provided AS-IS.
  *
  ******************************************************************************
  */
/* USER CODE END Header */

/* Includes ------------------------------------------------------------------*/
#include "main.h"
#include "stdio.h"
#include "stdlib.h"
#include "string.h"
#include "stdbool.h"

/* Private includes ----------------------------------------------------------*/
#include "NanoEdgeAI.h" // Include NanoEdge AI header
#include "knowledge.h"  // Include knowledge header generated by NanoEdge AI Suite

/* USER CODE BEGIN Includes */
/* USER CODE END Includes */

/* Private typedef -----------------------------------------------------------*/
/* USER CODE BEGIN PTD */
/* USER CODE END PTD */

/* Private define ------------------------------------------------------------*/
/* USER CODE BEGIN PD */
#define LMForward_Pin              GPIO_PIN_4  // Assuming GPIOB Pin 4 for Left Motor 1
#define LMReverse_Pin              GPIO_PIN_10  // Assuming GPIOB Pin 5 for Left Motor 2
#define RMForward_Pin              GPIO_PIN_7  // Assuming GPIOB Pin 6 for Right Motor 1
#define RMReverse_Pin              GPIO_PIN_6  // Assuming GPIOB Pin 7 for Right Motor 2

#define Buzzer_Pin           	   GPIO_PIN_8  // Assuming GPIOB Pin 9 for Buzzer
#define Pump_Pin                   GPIO_PIN_1  // Assuming GPIOB Pin 8 for Pump

#define MIN_PWM 500
#define DEGREE_PER_PWM_UNIT 11.11

// Define thresholds for flame detection
#define SAFE_DISTANCE 9

#define FLAME_THRESHOLD 1500  // Flame detected too close (adjust as needed)
#define FLAME_THRESHOLD_SAFE  3700 // Safe distance from flame (adjust as needed)
/* USER CODE END PD */

/* Private macro -------------------------------------------------------------*/
/* USER CODE BEGIN PM */
/* USER CODE END PM */

/* Private variables ---------------------------------------------------------*/
ADC_HandleTypeDef hadc1;
ADC_HandleTypeDef hadc2;
ADC_HandleTypeDef hadc3;

TIM_HandleTypeDef htim3;

UART_HandleTypeDef huart1;
UART_HandleTypeDef huart2;
uint8_t txData = 0x55;
uint8_t rxData[2];

uint16_t distance;

/* USER CODE BEGIN PV */
float fsleft, fsright, fsmiddle;
bool leftFlameSafe, rightFlameSafe, forwardFlameSafe;

int pos;
int duration;
int halt = 200;

/* NanoEdge AI buffers */
float input_user_buffer[DATA_INPUT_USER * AXIS_NUMBER]; // Buffer of input values
float output_class_buffer[CLASS_NUMBER]; // Buffer of class probabilities
uint16_t id_class = 0; // Point to id class (see argument of neai_classification fct)
const char *id2class[CLASS_NUMBER + 1] = { // Buffer for mapping class id to class name
	"unknown",
	"level1",
	"level2",
	"level3",
};
/* USER CODE END PV */

/* Private function prototypes -----------------------------------------------*/
void SystemClock_Config(void);
void PeriphCommonClock_Config(void);
static void MX_GPIO_Init(void);
static void MX_USART1_UART_Init(void);
static void MX_USART2_UART_Init(void);

static void MX_TIM3_Init(void);

void put_off_fire(uint16_t);
void SetServoAngle(int);

float ReadADC(ADC_HandleTypeDef* hadc);
uint16_t GetObjectDistance(void);

static void MX_ADC1_Init(void);
static void MX_ADC2_Init(void);
static void MX_ADC3_Init(void);

/* USER CODE BEGIN PFP */
/* USER CODE END PFP */

/* Private user code ---------------------------------------------------------*/
/* USER CODE BEGIN 0 */
int __io_putchar(int);
/* USER CODE END 0 */

/**
  * @brief  The application entry point.
  * @retval int
  */

int main(void)
{
  /* USER CODE BEGIN 1 */
  /* USER CODE END 1 */

  /* MCU Configuration--------------------------------------------------------*/
  /* Reset of all peripherals, Initializes the Flash interface and the Systick. */
  HAL_Init();

  /* USER CODE BEGIN Init */
  /* USER CODE END Init */

  /* Configure the system clock */
  SystemClock_Config();

  /* Configure the peripherals common clocks */
  PeriphCommonClock_Config();

  /* USER CODE BEGIN SysInit */
  /* USER CODE END SysInit */

  /* Initialize all configured peripherals */
  MX_GPIO_Init();
  MX_USART1_UART_Init();
  MX_USART2_UART_Init();
  MX_TIM3_Init();
  MX_ADC1_Init();
  MX_ADC2_Init();
  MX_ADC3_Init();

  HAL_TIM_PWM_Start(&htim3, TIM_CHANNEL_1);

  //Initialize the classification system
  neai_classification_init(knowledge);

  printf("Initialization complete.\r\n");

  /* USER CODE BEGIN 2 */
  /* USER CODE END 2 */

  /* Infinite loop */
  /* USER CODE BEGIN WHILE */
  while (1)
  {
  	  printf("\r\n");

  	  // Default motor and buzzer states
	  HAL_GPIO_WritePin(GPIOB, LMForward_Pin, GPIO_PIN_RESET);
      HAL_GPIO_WritePin(GPIOB, LMReverse_Pin, GPIO_PIN_RESET);
      HAL_GPIO_WritePin(GPIOC, RMForward_Pin, GPIO_PIN_RESET);
      HAL_GPIO_WritePin(GPIOB, RMReverse_Pin, GPIO_PIN_RESET);
      HAL_GPIO_WritePin(GPIOB, Buzzer_Pin, GPIO_PIN_RESET);

      SetServoAngle(90);

	  fsleft   = ReadADC(&hadc1); // ADC value for sensor 1
	  fsright  = ReadADC(&hadc2); // ADC value for sensor 2
	  fsmiddle = ReadADC(&hadc3); // ADC value for sensor 3

      printf("%f\t%f\t%f\r\n", fsleft, fsright, fsmiddle);

      GetObjectDistance();

      //Determine flame detection
      leftFlameSafe = (fsleft < FLAME_THRESHOLD_SAFE);
      rightFlameSafe = (fsright < FLAME_THRESHOLD_SAFE);
      forwardFlameSafe = (fsmiddle < FLAME_THRESHOLD_SAFE);

	  printf("LFS : %d \r\n", leftFlameSafe);
	  printf("RFS : %d \r\n", rightFlameSafe);
	  printf("FFS : %d \r\n", forwardFlameSafe);

      if( leftFlameSafe || rightFlameSafe || forwardFlameSafe ){
    	  HAL_GPIO_WritePin(GPIOB, Buzzer_Pin, SET);
      }

      if ( fsleft > FLAME_THRESHOLD && fsright > FLAME_THRESHOLD && fsmiddle > FLAME_THRESHOLD ){
    	  halt = 200;
    	  if (( leftFlameSafe && rightFlameSafe && forwardFlameSafe) || (!leftFlameSafe && !rightFlameSafe && forwardFlameSafe) ) {
    		  //Flame detected in the forward direction
				  halt = 200;
    			  HAL_GPIO_WritePin(GPIOB, LMForward_Pin, SET);
            	  HAL_GPIO_WritePin(GPIOB, LMReverse_Pin, RESET);
            	  HAL_GPIO_WritePin(GPIOC, RMForward_Pin, SET);
            	  HAL_GPIO_WritePin(GPIOB, RMReverse_Pin, RESET);
    	  } else if ( leftFlameSafe || ( leftFlameSafe && !rightFlameSafe && forwardFlameSafe ) ){
    		  //Flame detected on the left
    		  	   halt = 100;
            	   HAL_GPIO_WritePin(GPIOB, LMForward_Pin, RESET);
            	   HAL_GPIO_WritePin(GPIOB, LMReverse_Pin, RESET);
            	   HAL_GPIO_WritePin(GPIOC, RMForward_Pin, SET);
            	   HAL_GPIO_WritePin(GPIOB, RMReverse_Pin, RESET);
    	  } else if (rightFlameSafe || (!leftFlameSafe && rightFlameSafe && forwardFlameSafe) ){
               // Flame detected on the right
				  halt = 100;
    			  HAL_GPIO_WritePin(GPIOB, LMForward_Pin, SET);
    			  HAL_GPIO_WritePin(GPIOB, LMReverse_Pin, RESET);
            	  HAL_GPIO_WritePin(GPIOC, RMForward_Pin, RESET);
            	  HAL_GPIO_WritePin(GPIOB, RMReverse_Pin, RESET);
    	  }
      } else if ( fsleft <= FLAME_THRESHOLD || fsright <= FLAME_THRESHOLD || fsmiddle <= FLAME_THRESHOLD ){
    	  halt = 25;
		  distance = GetObjectDistance();
	        //Use ultrasonic sensor to move closer to the object
	        if ( distance > SAFE_DISTANCE + 5 ){
	            // Move forward until distance is 20 cm
	            HAL_GPIO_WritePin(GPIOB, LMForward_Pin, GPIO_PIN_SET);
	            HAL_GPIO_WritePin(GPIOB, LMReverse_Pin, GPIO_PIN_RESET);
	            HAL_GPIO_WritePin(GPIOC, RMForward_Pin, GPIO_PIN_SET);
	            HAL_GPIO_WritePin(GPIOB, RMReverse_Pin, GPIO_PIN_RESET);
	        }else if (distance < SAFE_DISTANCE - 3 ){
	            // Move backward if distance is less than 20 cm
	            HAL_GPIO_WritePin(GPIOB, LMForward_Pin, GPIO_PIN_RESET);
	            HAL_GPIO_WritePin(GPIOB, LMReverse_Pin, GPIO_PIN_SET);
	            HAL_GPIO_WritePin(GPIOC, RMForward_Pin, GPIO_PIN_RESET);
	            HAL_GPIO_WritePin(GPIOB, RMReverse_Pin, GPIO_PIN_SET);
	        }

	        if ( (SAFE_DISTANCE - 3 <= distance) && (distance <= SAFE_DISTANCE + 3) ){
	            // Stop and extinguish the fire when distance is 20 cm
	            HAL_GPIO_WritePin(GPIOB, LMForward_Pin, GPIO_PIN_RESET);
	            HAL_GPIO_WritePin(GPIOB, LMReverse_Pin, GPIO_PIN_RESET);
	            HAL_GPIO_WritePin(GPIOC, RMForward_Pin, GPIO_PIN_RESET);
	            HAL_GPIO_WritePin(GPIOB, RMReverse_Pin, GPIO_PIN_RESET);

//	            Fill input buffer for AI with sensor data
	            input_user_buffer[0] =  fsleft;
	            input_user_buffer[1] =  fsright;
	            input_user_buffer[2] =  fsmiddle;

//	            Print input buffer values (using correct format specifier for float)
	            printf("\r\nInput Values:\r\n");
	            printf("%f\t%f\t%f\r\n", input_user_buffer[0], input_user_buffer[1], input_user_buffer[2]);

//	            Perform AI classification
	            neai_classification(input_user_buffer, output_class_buffer, &id_class);

//	            Print classified class ID
	            printf("Class ID: %d\r\n", id_class);

//	            Print the corresponding class name
	            printf("Detected Class: %s\r\n", id2class[id_class]);

	            // Call the function to extinguish the fire
	            put_off_fire(id_class);
	        }
      }

      // Delay before the next loop iteration
      HAL_Delay(halt); // Delay between measurements

      /* USER CODE END WHILE */
  }
  /* USER CODE BEGIN 3 */
  /* USER CODE END 3 */
}

void put_off_fire(uint16_t class){

	printf("Inside put_off_fire\r\n");
    HAL_Delay(200);

    if( class == 1 ){
    	duration = 500;
    }else if( class == 2 ){
    	duration = 350;
    }else if (class == 3){
    	duration =200;
    }else{
    	duration = 100;
    }

    printf("Duration : %d\r\n",duration);

    // Activate motors to simulate a fire extinguishing action
    HAL_GPIO_WritePin(GPIOB, LMForward_Pin, RESET);
    HAL_GPIO_WritePin(GPIOB, LMReverse_Pin, RESET);
    HAL_GPIO_WritePin(GPIOC, RMForward_Pin, RESET);
    HAL_GPIO_WritePin(GPIOB, RMReverse_Pin, RESET);

    HAL_GPIO_WritePin(GPIOB, Pump_Pin, SET);
    HAL_Delay(duration);

    for (pos=30; pos<=150; pos++){
    	SetServoAngle(pos);
    	HAL_Delay(10);
    };

    for (pos=150; pos>=30; pos--){
    	SetServoAngle(pos);
    	HAL_Delay(10);
    };

    HAL_GPIO_WritePin(GPIOB, Pump_Pin, RESET);

    if( ReadADC(&hadc1) > FLAME_THRESHOLD_SAFE && ReadADC(&hadc2) > FLAME_THRESHOLD_SAFE && ReadADC(&hadc3) > FLAME_THRESHOLD_SAFE )
    {
        HAL_GPIO_WritePin(GPIOB, Buzzer_Pin, RESET);
    }

    SetServoAngle(90);

    printf("Done\r\n");
}

void SetServoAngle(int angle) {
     if (angle < 0) angle = 0; // Ensure angle is within bounds
     if (angle > 180) angle = 180;
     // Calculate PWM value
     int pwm_value = MIN_PWM + angle * DEGREE_PER_PWM_UNIT;
     __HAL_TIM_SET_COMPARE(&htim3, TIM_CHANNEL_1, pwm_value);
  }

float ReadADC(ADC_HandleTypeDef *hadc) {
    float adcValue = 0;

    // Start the ADC conversion
    HAL_ADC_Start(hadc);

    // Wait for the conversion to complete
    if (HAL_ADC_PollForConversion(hadc, HAL_MAX_DELAY) == HAL_OK) {
        // Get the converted value
        adcValue = HAL_ADC_GetValue(hadc);
    }

    // Stop the ADC conversion
    HAL_ADC_Stop(hadc);

    return adcValue;
}

uint16_t GetObjectDistance(void)
{
    uint16_t distance = 0;

    // Transmit data
    if (HAL_UART_Transmit(&huart1, &txData, 1, HAL_MAX_DELAY) != HAL_OK)
    {
        printf("Transmission Error\r\n");
        Error_Handler(); // Investigate error
    }

    // Receive data with a timeout
    if (HAL_UART_Receive(&huart1, rxData, 2, 1000) == HAL_OK) // 1 second timeout
    {
        uint16_t highByte = rxData[0];
        uint16_t lowByte = rxData[1];
        distance = ((highByte << 8) | lowByte) / 10;

        if (distance > 1 && distance < 10000)
        {
            printf("Distance= %d\r\n", distance);
        }
        else
        {
            printf("Distance out of range: %d\r\n", distance);
        }
    }
    else
    {
        printf("Receive Error\r\n");
    }

    return distance;
}

/**
  * @brief System Clock Configuration
  * @retval None
  */
void SystemClock_Config(void)
{
  RCC_OscInitTypeDef RCC_OscInitStruct = {0};
  RCC_ClkInitTypeDef RCC_ClkInitStruct = {0};

  /** Configure the main internal regulator output voltage
  */
  if (HAL_PWREx_ControlVoltageScaling(PWR_REGULATOR_VOLTAGE_SCALE1) != HAL_OK)
  {
    Error_Handler();
  }

  /** Initializes the RCC Oscillators according to the specified parameters
  * in the RCC_OscInitTypeDef structure.
  */
  RCC_OscInitStruct.OscillatorType = RCC_OSCILLATORTYPE_HSI;
  RCC_OscInitStruct.HSIState = RCC_HSI_ON;
  RCC_OscInitStruct.HSICalibrationValue = RCC_HSICALIBRATION_DEFAULT;
  RCC_OscInitStruct.PLL.PLLState = RCC_PLL_ON;
  RCC_OscInitStruct.PLL.PLLSource = RCC_PLLSOURCE_HSI;
  RCC_OscInitStruct.PLL.PLLM = 1;
  RCC_OscInitStruct.PLL.PLLN = 10;
  RCC_OscInitStruct.PLL.PLLP = RCC_PLLP_DIV7;
  RCC_OscInitStruct.PLL.PLLQ = RCC_PLLQ_DIV2;
  RCC_OscInitStruct.PLL.PLLR = RCC_PLLR_DIV2;
  if (HAL_RCC_OscConfig(&RCC_OscInitStruct) != HAL_OK)
  {
    Error_Handler();
  }

  /** Initializes the CPU, AHB and APB buses clocks
  */
  RCC_ClkInitStruct.ClockType = RCC_CLOCKTYPE_HCLK|RCC_CLOCKTYPE_SYSCLK
                              |RCC_CLOCKTYPE_PCLK1|RCC_CLOCKTYPE_PCLK2;
  RCC_ClkInitStruct.SYSCLKSource = RCC_SYSCLKSOURCE_PLLCLK;
  RCC_ClkInitStruct.AHBCLKDivider = RCC_SYSCLK_DIV1;
  RCC_ClkInitStruct.APB1CLKDivider = RCC_HCLK_DIV1;
  RCC_ClkInitStruct.APB2CLKDivider = RCC_HCLK_DIV1;

  if (HAL_RCC_ClockConfig(&RCC_ClkInitStruct, FLASH_LATENCY_4) != HAL_OK)
  {
    Error_Handler();
  }
}

/**
  * @brief Peripherals Common Clock Configuration
  * @retval None
  */
void PeriphCommonClock_Config(void)
{
  RCC_PeriphCLKInitTypeDef PeriphClkInit = {0};

  /** Initializes the peripherals clock
  */
  PeriphClkInit.PeriphClockSelection = RCC_PERIPHCLK_ADC;
  PeriphClkInit.AdcClockSelection = RCC_ADCCLKSOURCE_PLLSAI1;
  PeriphClkInit.PLLSAI1.PLLSAI1Source = RCC_PLLSOURCE_HSI;
  PeriphClkInit.PLLSAI1.PLLSAI1M = 1;
  PeriphClkInit.PLLSAI1.PLLSAI1N = 8;
  PeriphClkInit.PLLSAI1.PLLSAI1P = RCC_PLLP_DIV7;
  PeriphClkInit.PLLSAI1.PLLSAI1Q = RCC_PLLQ_DIV2;
  PeriphClkInit.PLLSAI1.PLLSAI1R = RCC_PLLR_DIV2;
  PeriphClkInit.PLLSAI1.PLLSAI1ClockOut = RCC_PLLSAI1_ADC1CLK;
  if (HAL_RCCEx_PeriphCLKConfig(&PeriphClkInit) != HAL_OK)
  {
    Error_Handler();
  }
}

/**
  * @brief ADC1 Initialization Function
  * @param None
  * @retval None
  */
static void MX_ADC1_Init(void)
{

  /* USER CODE BEGIN ADC1_Init 0 */

  /* USER CODE END ADC1_Init 0 */

  ADC_MultiModeTypeDef multimode = {0};
  ADC_ChannelConfTypeDef sConfig = {0};

  /* USER CODE BEGIN ADC1_Init 1 */

  /* USER CODE END ADC1_Init 1 */

  /** Common config
  */
  hadc1.Instance = ADC1;
  hadc1.Init.ClockPrescaler = ADC_CLOCK_ASYNC_DIV1;
  hadc1.Init.Resolution = ADC_RESOLUTION_12B;
  hadc1.Init.DataAlign = ADC_DATAALIGN_RIGHT;
  hadc1.Init.ScanConvMode = ADC_SCAN_DISABLE;
  hadc1.Init.EOCSelection = ADC_EOC_SINGLE_CONV;
  hadc1.Init.LowPowerAutoWait = DISABLE;
  hadc1.Init.ContinuousConvMode = DISABLE;
  hadc1.Init.NbrOfConversion = 1;
  hadc1.Init.DiscontinuousConvMode = DISABLE;
  hadc1.Init.ExternalTrigConv = ADC_SOFTWARE_START;
  hadc1.Init.ExternalTrigConvEdge = ADC_EXTERNALTRIGCONVEDGE_NONE;
  hadc1.Init.DMAContinuousRequests = DISABLE;
  hadc1.Init.Overrun = ADC_OVR_DATA_PRESERVED;
  hadc1.Init.OversamplingMode = DISABLE;
  if (HAL_ADC_Init(&hadc1) != HAL_OK)
  {
    Error_Handler();
  }

  /** Configure the ADC multi-mode
  */
  multimode.Mode = ADC_MODE_INDEPENDENT;
  if (HAL_ADCEx_MultiModeConfigChannel(&hadc1, &multimode) != HAL_OK)
  {
    Error_Handler();
  }

  /** Configure Regular Channel
  */
  sConfig.Channel = ADC_CHANNEL_1;
  sConfig.Rank = ADC_REGULAR_RANK_1;
  sConfig.SamplingTime = ADC_SAMPLETIME_2CYCLES_5;
  sConfig.SingleDiff = ADC_SINGLE_ENDED;
  sConfig.OffsetNumber = ADC_OFFSET_NONE;
  sConfig.Offset = 0;
  if (HAL_ADC_ConfigChannel(&hadc1, &sConfig) != HAL_OK)
  {
    Error_Handler();
  }
  /* USER CODE BEGIN ADC1_Init 2 */

  /* USER CODE END ADC1_Init 2 */

}

/**
  * @brief ADC2 Initialization Function
  * @param None
  * @retval None
  */
static void MX_ADC2_Init(void)
{

  /* USER CODE BEGIN ADC2_Init 0 */

  /* USER CODE END ADC2_Init 0 */

  ADC_ChannelConfTypeDef sConfig = {0};

  /* USER CODE BEGIN ADC2_Init 1 */

  /* USER CODE END ADC2_Init 1 */

  /** Common config
  */
  hadc2.Instance = ADC2;
  hadc2.Init.ClockPrescaler = ADC_CLOCK_ASYNC_DIV1;
  hadc2.Init.Resolution = ADC_RESOLUTION_12B;
  hadc2.Init.DataAlign = ADC_DATAALIGN_RIGHT;
  hadc2.Init.ScanConvMode = ADC_SCAN_DISABLE;
  hadc2.Init.EOCSelection = ADC_EOC_SINGLE_CONV;
  hadc2.Init.LowPowerAutoWait = DISABLE;
  hadc2.Init.ContinuousConvMode = DISABLE;
  hadc2.Init.NbrOfConversion = 1;
  hadc2.Init.DiscontinuousConvMode = DISABLE;
  hadc2.Init.ExternalTrigConv = ADC_SOFTWARE_START;
  hadc2.Init.ExternalTrigConvEdge = ADC_EXTERNALTRIGCONVEDGE_NONE;
  hadc2.Init.DMAContinuousRequests = DISABLE;
  hadc2.Init.Overrun = ADC_OVR_DATA_PRESERVED;
  hadc2.Init.OversamplingMode = DISABLE;
  if (HAL_ADC_Init(&hadc2) != HAL_OK)
  {
    Error_Handler();
  }

  /** Configure Regular Channel
  */
  sConfig.Channel = ADC_CHANNEL_2;
  sConfig.Rank = ADC_REGULAR_RANK_1;
  sConfig.SamplingTime = ADC_SAMPLETIME_2CYCLES_5;
  sConfig.SingleDiff = ADC_SINGLE_ENDED;
  sConfig.OffsetNumber = ADC_OFFSET_NONE;
  sConfig.Offset = 0;
  if (HAL_ADC_ConfigChannel(&hadc2, &sConfig) != HAL_OK)
  {
    Error_Handler();
  }
  /* USER CODE BEGIN ADC2_Init 2 */

  /* USER CODE END ADC2_Init 2 */

}

/**
  * @brief ADC3 Initialization Function
  * @param None
  * @retval None
  */
static void MX_ADC3_Init(void)
{

  /* USER CODE BEGIN ADC3_Init 0 */

  /* USER CODE END ADC3_Init 0 */

  ADC_ChannelConfTypeDef sConfig = {0};

  /* USER CODE BEGIN ADC3_Init 1 */

  /* USER CODE END ADC3_Init 1 */

  /** Common config
  */
  hadc3.Instance = ADC3;
  hadc3.Init.ClockPrescaler = ADC_CLOCK_ASYNC_DIV1;
  hadc3.Init.Resolution = ADC_RESOLUTION_12B;
  hadc3.Init.DataAlign = ADC_DATAALIGN_RIGHT;
  hadc3.Init.ScanConvMode = ADC_SCAN_DISABLE;
  hadc3.Init.EOCSelection = ADC_EOC_SINGLE_CONV;
  hadc3.Init.LowPowerAutoWait = DISABLE;
  hadc3.Init.ContinuousConvMode = DISABLE;
  hadc3.Init.NbrOfConversion = 1;
  hadc3.Init.DiscontinuousConvMode = DISABLE;
  hadc3.Init.ExternalTrigConv = ADC_SOFTWARE_START;
  hadc3.Init.ExternalTrigConvEdge = ADC_EXTERNALTRIGCONVEDGE_NONE;
  hadc3.Init.DMAContinuousRequests = DISABLE;
  hadc3.Init.Overrun = ADC_OVR_DATA_PRESERVED;
  hadc3.Init.OversamplingMode = DISABLE;
  if (HAL_ADC_Init(&hadc3) != HAL_OK)
  {
    Error_Handler();
  }

  /** Configure Regular Channel
  */
  sConfig.Channel = ADC_CHANNEL_3;
  sConfig.Rank = ADC_REGULAR_RANK_1;
  sConfig.SamplingTime = ADC_SAMPLETIME_2CYCLES_5;
  sConfig.SingleDiff = ADC_SINGLE_ENDED;
  sConfig.OffsetNumber = ADC_OFFSET_NONE;
  sConfig.Offset = 0;
  if (HAL_ADC_ConfigChannel(&hadc3, &sConfig) != HAL_OK)
  {
    Error_Handler();
  }
  /* USER CODE BEGIN ADC3_Init 2 */

  /* USER CODE END ADC3_Init 2 */

}

/**
  * @brief TIM3 Initialization Function
  * @param None
  * @retval None
  */
static void MX_TIM3_Init(void)
{

  /* USER CODE BEGIN TIM3_Init 0 */

  /* USER CODE END TIM3_Init 0 */

  TIM_ClockConfigTypeDef sClockSourceConfig = {0};
  TIM_MasterConfigTypeDef sMasterConfig = {0};
  TIM_OC_InitTypeDef sConfigOC = {0};

  /* USER CODE BEGIN TIM3_Init 1 */

  /* USER CODE END TIM3_Init 1 */
  htim3.Instance = TIM3;
  htim3.Init.Prescaler = 79;
  htim3.Init.CounterMode = TIM_COUNTERMODE_UP;
  htim3.Init.Period = 19999;
  htim3.Init.ClockDivision = TIM_CLOCKDIVISION_DIV1;
  htim3.Init.AutoReloadPreload = TIM_AUTORELOAD_PRELOAD_DISABLE;
  if (HAL_TIM_Base_Init(&htim3) != HAL_OK)
  {
    Error_Handler();
  }
  sClockSourceConfig.ClockSource = TIM_CLOCKSOURCE_INTERNAL;
  if (HAL_TIM_ConfigClockSource(&htim3, &sClockSourceConfig) != HAL_OK)
  {
    Error_Handler();
  }
  if (HAL_TIM_PWM_Init(&htim3) != HAL_OK)
  {
    Error_Handler();
  }
  sMasterConfig.MasterOutputTrigger = TIM_TRGO_RESET;
  sMasterConfig.MasterSlaveMode = TIM_MASTERSLAVEMODE_DISABLE;
  if (HAL_TIMEx_MasterConfigSynchronization(&htim3, &sMasterConfig) != HAL_OK)
  {
    Error_Handler();
  }
  sConfigOC.OCMode = TIM_OCMODE_PWM1;
  sConfigOC.Pulse = 0;
  sConfigOC.OCPolarity = TIM_OCPOLARITY_HIGH;
  sConfigOC.OCFastMode = TIM_OCFAST_DISABLE;
  if (HAL_TIM_PWM_ConfigChannel(&htim3, &sConfigOC, TIM_CHANNEL_1) != HAL_OK)
  {
    Error_Handler();
  }
  /* USER CODE BEGIN TIM3_Init 2 */

  /* USER CODE END TIM3_Init 2 */
  HAL_TIM_MspPostInit(&htim3);

}

/**
  * @brief USART1 Initialization Function
  * @param None
  * @retval None
  */
static void MX_USART1_UART_Init(void)
{

  /* USER CODE BEGIN USART1_Init 0 */

  /* USER CODE END USART1_Init 0 */

  /* USER CODE BEGIN USART1_Init 1 */

  /* USER CODE END USART1_Init 1 */
  huart1.Instance = USART1;
  huart1.Init.BaudRate = 9600;
  huart1.Init.WordLength = UART_WORDLENGTH_8B;
  huart1.Init.StopBits = UART_STOPBITS_1;
  huart1.Init.Parity = UART_PARITY_NONE;
  huart1.Init.Mode = UART_MODE_TX_RX;
  huart1.Init.HwFlowCtl = UART_HWCONTROL_NONE;
  huart1.Init.OverSampling = UART_OVERSAMPLING_16;
  huart1.Init.OneBitSampling = UART_ONE_BIT_SAMPLE_DISABLE;
  huart1.AdvancedInit.AdvFeatureInit = UART_ADVFEATURE_NO_INIT;
  if (HAL_UART_Init(&huart1) != HAL_OK)
  {
    Error_Handler();
  }
  /* USER CODE BEGIN USART1_Init 2 */

  /* USER CODE END USART1_Init 2 */

}

/**
  * @brief USART2 Initialization Function
  * @param None
  * @retval None
  */
static void MX_USART2_UART_Init(void)
{

  /* USER CODE BEGIN USART2_Init 0 */

  /* USER CODE END USART2_Init 0 */

  /* USER CODE BEGIN USART2_Init 1 */

  /* USER CODE END USART2_Init 1 */
  huart2.Instance = USART2;
  huart2.Init.BaudRate = 115200;
  huart2.Init.WordLength = UART_WORDLENGTH_8B;
  huart2.Init.StopBits = UART_STOPBITS_1;
  huart2.Init.Parity = UART_PARITY_NONE;
  huart2.Init.Mode = UART_MODE_TX_RX;
  huart2.Init.HwFlowCtl = UART_HWCONTROL_NONE;
  huart2.Init.OverSampling = UART_OVERSAMPLING_16;
  huart2.Init.OneBitSampling = UART_ONE_BIT_SAMPLE_DISABLE;
  huart2.AdvancedInit.AdvFeatureInit = UART_ADVFEATURE_NO_INIT;
  if (HAL_UART_Init(&huart2) != HAL_OK)
  {
    Error_Handler();
  }
  /* USER CODE BEGIN USART2_Init 2 */

  /* USER CODE END USART2_Init 2 */

}

/**
  * @brief GPIO Initialization Function
  * @param None
  * @retval None
  */
static void MX_GPIO_Init(void)
{
  GPIO_InitTypeDef GPIO_InitStruct = {0};
/* USER CODE BEGIN MX_GPIO_Init_1 */
/* USER CODE END MX_GPIO_Init_1 */

  /* GPIO Ports Clock Enable */
  __HAL_RCC_GPIOC_CLK_ENABLE();
  __HAL_RCC_GPIOA_CLK_ENABLE();
  __HAL_RCC_GPIOB_CLK_ENABLE();

  /*Configure GPIO pin Output Level */
  HAL_GPIO_WritePin(GPIOB, Pump_24_Pin|LMReverse_D6_Pin|LMForward_D5_Pin|RMReverse_D10_Pin
                          |Buzzer_Pin, GPIO_PIN_RESET);

  /*Configure GPIO pin Output Level */
  HAL_GPIO_WritePin(RMForward_D9_GPIO_Port, RMForward_D9_Pin, GPIO_PIN_RESET);

  /*Configure GPIO pins : Pump_24_Pin LMReverse_D6_Pin LMForward_D5_Pin RMReverse_D10_Pin
                           Buzzer_Pin */
  GPIO_InitStruct.Pin = Pump_24_Pin|LMReverse_D6_Pin|LMForward_D5_Pin|RMReverse_D10_Pin
                          |Buzzer_Pin;
  GPIO_InitStruct.Mode = GPIO_MODE_OUTPUT_PP;
  GPIO_InitStruct.Pull = GPIO_NOPULL;
  GPIO_InitStruct.Speed = GPIO_SPEED_FREQ_LOW;
  HAL_GPIO_Init(GPIOB, &GPIO_InitStruct);

  /*Configure GPIO pin : RMForward_D9_Pin */
  GPIO_InitStruct.Pin = RMForward_D9_Pin;
  GPIO_InitStruct.Mode = GPIO_MODE_OUTPUT_PP;
  GPIO_InitStruct.Pull = GPIO_NOPULL;
  GPIO_InitStruct.Speed = GPIO_SPEED_FREQ_LOW;
  HAL_GPIO_Init(RMForward_D9_GPIO_Port, &GPIO_InitStruct);

/* USER CODE BEGIN MX_GPIO_Init_2 */
/* USER CODE END MX_GPIO_Init_2 */
}

/* USER CODE BEGIN 4 */
int __io_putchar(int ch){
    HAL_UART_Transmit(&huart2, (uint8_t *)&ch, 1, HAL_MAX_DELAY);
    return ch;
}
/* USER CODE END 4 */

/**
  * @brief  This function is executed in case of error occurrence.
  * @retval None
  */
void Error_Handler(void)
{
  /* USER CODE BEGIN Error_Handler_Debug */
  /* User can add his own implementation to report the HAL error return state */
  __disable_irq();
  while (1)
  {
  }
  /* USER CODE END Error_Handler_Debug */
}

#ifdef  USE_FULL_ASSERT
/**
  * @brief  Reports the name of the source file and the source line number
  *         where the assert_param error has occurred.
  * @param  file: pointer to the source file name
  * @param  line: assert_param error line source number
  * @retval None
  */
void assert_failed(uint8_t *file, uint32_t line)
{
  /* USER CODE BEGIN 6 */
  /* User can add his own implementation to report the file name and line number,
     ex: printf("Wrong parameters value: file %s on line %d\r\n", file, line) */
  /* USER CODE END 6 */
}
#endif /* USE_FULL_ASSERT */
